MEMORY
{
    IROM	(r x) : ORIGIN = 0x08000000, LENGTH = 512k
    ITCM    (rwx) : ORIGIN = 0x10000000, LENGTH = 32k
	IRAM    (rwx) : ORIGIN = 0x20000000, LENGTH = 128k
}

REGION_ALIAS("STACK", IRAM);

INCLUDE stm32l4.ld
